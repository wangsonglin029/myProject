/**
  ******************************************************************************
  * @file    system_ac1003.c
  * @author  MCU Application Team
  * @version V0.0.0
  * @date    05-December-2018
  * @brief   CMSIS Cortex-M0 Device Peripheral Access Layer System Source File.
  *          This file contains the system clock configuration for AC1003 devices,
  *          and is generated by the clock configuration tool
  *          AC1003_Clock_Configuration_V1.0.0.xls
  *
  * 1.  This file provides two functions and one global variable to be called from
  *     user application:
  *      - SystemInit(): Setups the system clock (System clock source,
                         Divider factors, AHB/APBx prescalers and Flash settings),
  *                      depending on the configuration made in the clock xls tool.
  *                      This function is called at startup just after reset and
  *                      before branch to main program. This call is made inside
  *                      the "startup_ac1003.s" file.
  *
  *      - SystemCoreClock variable: Contains the core clock (HCLK), it can be used
  *                                  by the user application to setup the SysTick
  *                                  timer or configure other parameters.
  *
  *      - SystemCoreClockUpdate(): Updates the variable SystemCoreClock and must
  *                                 be called whenever the core clock is changed
  *                                 during program execution.
  *
  * 2. After each device reset the HSI (8 MHz Range) is used as system clock source.
  *    Then SystemInit() function is called, in "startup_ac1003.s" file, to
  *    configure the system clock before to branch to main program.
  *
  * 3. If the system clock source selected by user fails to startup, the SystemInit()
  *    function will do nothing and HSI still used as system clock source. User can
  *    add some code to deal with this issue inside the SetSysClock() function.
  *
  * 4. The default value of HSE crystal is set to 8MHz, refer to "HSE_VALUE" define
  *    in "ac1003.h" file.  you are using different crystal you have to adapt the HSE
  *    value to your own configuration.
  *
  * 5. This file configures the system clock as follows:
  *=============================================================================
  *                         System Clock Configuration
  *=============================================================================

  *-----------------------------------------------------------------------------
  *        SYSCLK                       | 24000000 Hz
  *-----------------------------------------------------------------------------
  *        HCLK                         | 24000000 Hz
  *-----------------------------------------------------------------------------
  *        AHB Prescaler                | 1
  *-----------------------------------------------------------------------------
  *        APB Prescaler                | 1
  *-----------------------------------------------------------------------------
  *        VDD                          | 3.3 V
  *-----------------------------------------------------------------------------
   *=============================================================================
  *****************************************************************************
  */

/** @addtogroup CMSIS
  * @{
  */

/** @addtogroup AC1003_system
  * @{
  */

/** @addtogroup AC1003_System_Private_Includes
  * @{
  */

#include "ac1003.h"
#include "ac1003_rcc.h"



/** @addtogroup AC1003_System_Private_TypesDefinitions
  * @{
  */

/** @addtogroup AC1003_System_Private_Defines
  * @{
  */
#if !defined  (HXT_VALUE)
//#define HXT_VALUE    ((uint32_t)8000000) /*!< Value of the External oscillator in Hz */
#define HXT_VALUE    ((uint32_t)24000000) /*!< Value of the External oscillator in Hz */
#endif /* HXT_VALUE */

#if !defined  (LXT_VALUE)
#define LXT_VALUE    ((uint32_t)32768) /*!< Value of the External oscillator in Hz*/
#endif /* LXT_VALUE */


/** @addtogroup AC1003_System_Private_Macros
  * @{
  */

/** @addtogroup AC1003_System_Private_Variables
  * @{
  */
uint32_t SystemCoreClock          = 4000000;		/*!< System Clock Frequency Default(Core Clock) */
uint32_t AhbClock                 = 4000000;
uint32_t ApbClock                 = 4000000;



/** @addtogroup AC1003_System_Private_FunctionPrototypes
  * @{
  */

/**
  * @}
  */

/** @addtogroup AC1003_System_Private_Functions
  * @{
  */

/**
  * @brief  Setup the microcontroller system.
  * @param  None
  * @retval None
  */
void SystemInit (void)
{
    /* Reset the RCC clock configuration to the default reset state(for debug purpose) */
    /* Set HIRCEN bit, Reset HXTEN, HXTBYP, LIRCEN*/
    RCC->UNLOCK = RCC_REGLOCKKEY;
    RCC->SYSCLKCR = RCC_SYSCLKSource_HIRC | RCC_CLKCONKEY;
    RCC->UNLOCK = RCC_RESGLOCKKEY;

    /* Reset HCLK and PCLK div bits */
    RCC->HCLKDIV = 0x00000000;
    RCC->PCLKDIV = 0x0000000;

    /* Reset AHB and APB module */
    RCC->HCLKEN = 0x00000100;
    RCC->PCLKEN = 0x00000000;

    /* Reset MCO bits */
    RCC->MCOCR = 0x00000000;
}

/**
  * @brief  Update SystemCoreClock according to Clock Register Values
  *         The SystemCoreClock variable contains the core clock (HCLK), it can
  *         be used by the user application to setup the SysTick timer or configure
  *         other parameters.
  *
  * @note   Each time the core clock (HCLK) changes, this function must be called
  *         to update SystemCoreClock variable value. Otherwise, any configuration
  *         based on this variable will be incorrect.
  *
  * @note   - The system frequency computed by this function is not the real
  *           frequency in the chip. It is calculated based on the predefined
  *           constant and the selected clock source:
  * @param  None
  * @retval None
  */
void SystemCoreClockUpdate (void)
{
    uint32_t tmp = 0U;
    uint32_t value = 0;

    /* Get SYSCLK source -------------------------------------------------------*/
    tmp = RCC->SYSCLKSEL & RCC_SYSCLKSource_EN_MASK;

    switch (tmp)
    {
    case RCC_SYSCLKSource_HIRC:  /* HIRC used as system clock */
        value = (uint32_t)(RCC->HIRCCR & 0xfff);
        if((value == HIRC24M_TRIMVALUE_A) || (value == HIRC24M_TRIMVALUE_C))
        {
            SystemCoreClock = HIRC_VALUE_24M;
        }
        else if((value == HIRC22M_TRIMVALUE_A) || (value == HIRC22M_TRIMVALUE_C))
        {
            SystemCoreClock = HIRC_VALUE_22M;
        }
        else if((value == HIRC16M_TRIMVALUE_A) || (value == HIRC16M_TRIMVALUE_C))
        {
            SystemCoreClock = HIRC_VALUE_16M;
        }
        else if((value == HIRC8M_TRIMVALUE_A) || (value == HIRC8M_TRIMVALUE_C))
        {
            SystemCoreClock = HIRC_VALUE_8M;
        }
        else if((value == HIRC4M_TRIMVALUE_A) || (value == HIRC4M_TRIMVALUE_C))
        {
            SystemCoreClock = HIRC_VALUE_4M;
        }
        else
        {
            SystemCoreClock = HIRC_VALUE_24M;
        }
        break;
    case RCC_SYSCLKSource_HXT:  /* HXT used as system clock */
        SystemCoreClock = HXT_VALUE;
        break;
    case RCC_SYSCLKSource_LIRC:  /* LIRC used as system clock */
        value = (uint32_t)(RCC->LIRCCR & 0xff);
        if((value == LIRC32K_TRIMVALUE_B) || (value == LIRC32K_TRIMVALUE_D))
        {
            SystemCoreClock = LIRC_VALUE_32K;
        }
        else
        {
            SystemCoreClock = LIRC_VALUE_38K;
        }
        break;
    case RCC_SYSCLKSource_LXT:  /* LXT used as system clock */
        SystemCoreClock = LXT_VALUE;
        break;
    default:
        SystemCoreClock = HIRC_VALUE_4M;
        break;
    }

    /* Compute HCLK clock frequency ----------------*/
    if((RCC->HCLKDIV & 0xff) != 0)
        AhbClock = (SystemCoreClock >> 1) / (RCC->HCLKDIV & 0xff);
    else
        AhbClock = SystemCoreClock;

    /* Compute PCLK clock frequency ----------------*/
    if((RCC->PCLKDIV & 0xff) != 0)
        ApbClock = (AhbClock >> 1) / (RCC->PCLKDIV & 0xff);
    else
        ApbClock = AhbClock;
}






/**
  * @}
  */

/**
  * @}
  */

/**
  * @}
  */

/************************ (C) COPYRIGHT  AC1003*****END OF FILE****/
